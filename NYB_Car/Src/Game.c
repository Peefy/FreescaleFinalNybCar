#include "include.h"   //包含必要的头文件
/*************NOT FINISHED***************/
#define SX     50
#define SY     25
#define Length 10
#define Xnub   50
#define Ynub   40

#define Xmin       0
#define Xmax       127
#define Ymin       0
#define Ymax       63
#define YminPage   0
#define YmaxPage   7
uint16 Data[125];
uint16 AD_Data;
uint8  Yplay;
uint8 Tian0BMP[]=     //127*64

{0xFF,0x01,0x01,0x01,0x01,0x01,0x01,0x01,0x01,0x01,0x01,0x01,0x01,0x01,0x01,0x01,
 0x01,0x01,0x01,0x01,0x01,0x01,0x01,0x01,0x01,0x01,0x01,0x01,0x01,0x01,0x01,0x01,
 0x01,0x01,0x01,0x01,0x01,0x01,0x01,0x01,0x01,0x01,0x01,0x01,0x01,0x01,0x01,0x01,
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 0xC0,0xC0,0xC0,0xC0,0xC0,0xC0,0xC0,0xFF};          /*"田",*/

uint8 SanJiaoBMP[]=       //127*64

{0xFF,0x01,0x01,0x01,0x01,0x01,0x01,0x01,0x01,0x01,0x01,0x01,0x01,0x01,0x01,0x01,
 0x01,0x01,0x01,0x01,0x01,0x01,0x01,0x01,0x01,0x01,0x01,0x01,0x01,0x01,0x01,0x01,
 0x01,0x01,0x01,0x01,0x01,0x01,0x01,0x01,0x01,0x01,0x01,0x01,0x01,0x01,0x01,0x01,
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 0xC0,0xC0,0xC0,0xC0,0xC0,0xC0,0xC0,0xFF};

uint8 FangboBMP[]=       //127*64

{0xFF,0x01,0x01,0x01,0x01,0x01,0x01,0x01,0x01,0x01,0x01,0x01,0x01,0x01,0x01,0x01,
 0x01,0x01,0x01,0x01,0x01,0x01,0x01,0x01,0x01,0x01,0x01,0x01,0x01,0x01,0x01,0x01,
 0x01,0x01,0x01,0x01,0x01,0x01,0x01,0x01,0x01,0x01,0x01,0x01,0x01,0x01,0x01,0x01,
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 0xC0,0xC0,0xC0,0xC0,0xC0,0xC0,0xC0,0xFF};

uint8 SinBMP[]=          //127*64

{0xFF,0x01,0x01,0x01,0x01,0x01,0x01,0x01,0x01,0x01,0xC1,0x71,0x19,0x0D,0x05,0x07,
 0x03,0x07,0x05,0x0D,0x19,0x71,0xC1,0x01,0x01,0x01,0x01,0x01,0x01,0x01,0x01,0x01,
 0x01,0x01,0x01,0x01,0x01,0x01,0x01,0x01,0x01,0x01,0x01,0x01,0x01,0x01,0x01,0x01,
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 0xC0,0xC0,0xC0,0xC0,0xC0,0xC0,0xC0,0xFF};

uint8 TianBMP[]=     //127*48

{0xFF,0x01,0x01,0x01,0x01,0x01,0x01,0x01,0x01,0x01,0x01,0x01,0x01,0x01,0x01,0x01,
 0x01,0x01,0x01,0x01,0x01,0x01,0x01,0x01,0x01,0x01,0x01,0x01,0x01,0x01,0x01,0x01,
 0x01,0x01,0x01,0x01,0x01,0x01,0x01,0x01,0x01,0x01,0x01,0x01,0x01,0x01,0x01,0x01,
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 0xC0,0xC0,0xC0,0xC0,0xC0,0xC0,0xC0,0xC0,0xC0,0xFF};

uint8 Game_Mode=0;
uint8 Game_Mode_=0;
uint8 Game_Key=0;
GST Gamestatus = START;
GST Gamestatus_Pre = START;
MF  Moveflag=Right;
BA  BoxArray[500];


char StartX;     /*蛇头位置*/
char StartY;
char StartC;
char EndX;       /*蛇尾位置*/
char EndY;
char RandX=0;    /*随机位置*/
char RandY=0;
char RandC=0;

int rand(void)
{ 
  static int next=1;
  next = next * 1103515245 + 12345;   
  return (next/65536) % 32768;
}

/*void GiveFood()
{
 while(1)
 {
 RandX=rand()%Xnub;
 RandY=rand()%Ynub;
 RandC=rand()%15+1;
    for(i=0;i<BoxNub;i++)if(RandX==BoxArray[i].x && RandY==BoxArray[i].y )j=1;
 if(!j)break;
 }*/

void LCD_PutSnakeDot(char x,char y)
{
   LCD_PutPixel(2*x,2*y); LCD_PutPixel(2*x,2*y+1);
   LCD_PutPixel(2*x+1,2*y);LCD_PutPixel(2*x+1,2*y+1); 
}

void Snake_Init(void)
{  
  //LCD_PutPixel1(64,32);
}

void ClearTail(void)
{
    
}

void DisplayHead(void)
{
    
}

void Snake_Move(void)
{
   switch(Moveflag)
   {
     
      case Left:
        break;
      case Right:
        ClearTail();
        DisplayHead();
        break;
      case Up:
        break;
      case Down:
        break;
   }
}
uint8 i,j;
/*void Oscilloscope(void)
{
   for(;;)
   { 
      if (Game_Mode ==0) 
      {  
         //kaiji_fmq();    //蜂鸣器响。。
         Gamestatus = START;
         LCD_CLS();
      }
      Game_Mode=1; 
      switch(Gamestatus)        
      {
        case START:
          for(i=Xmin+2;i<Xmax;i++)
          {
             LCD_PutPixel(i,Ymin);            
             LCD_PutPixel(i,Ymax);
          }
          for(i=YminPage;i<=YmaxPage;i++)
          {
             LCD_Draw_One_Row(Xmin,i,0xff);
             LCD_Draw_One_Row(Xmax,i,0xff);
          }
          LCD_P6x8Str(6,2," Press  OK  Key ");
          LCD_P6x8Str(6,3,"  To Continue!  ");        
          LCD_P6x8Str(6,4,"   --Made By DuGu"); 
          break;
        case ING:  
          if(Gamestatus_Pre==START)        //显示波形
          {
              LCD_CLS();
              Draw_BMP(0,2,126,7,TianBMP);              
              LCD_P6x8Str(0,0,"Freq");
              LCD_P6x8Str(0,1,"Vpp");
              //LCD_Draw_One_Row(0,56,0x80);
              //LCD_Draw_One_Row(1,78,0x01);          
          }
          //Draw_BMP(0,0,126,7,TianBMP);
          //Draw_BMP(0,0,126,7,SanJiaoBMP);
          //Draw_BMP(0,0,126,7,FangboBMP);
          Draw_BMP(0,0,126,7,SinBMP);          
          for(i=2;i<125;i++)  //小型示波器
          {   
              if(Data[i]<=7)
                j=4;
              else if(Data[i]>=8&&Data[i]<=15)
                j=3;
              else
                j=2;
              switch(j)
              {
              case 4:
                Yplay=Data[i];   
                break;
              case 3:
                Yplay=Data[i]-8;
                break;
              case 2:
                Yplay=Data[i]-16;
                break;
              }
              j_Pre=j;
              switch(Yplay)
              {
                case 0:Yplay=0x80;break;
                case 1:Yplay=0x40;break;
                case 2:Yplay=0x20;break;
                case 3:Yplay=0x10;break;
                case 4:Yplay=0x08;break;
                case 5:Yplay=0x04;break;
                case 6:Yplay=0x02;break;
                case 7:Yplay=0x01;break;
              }
              switch(j)
              {
              case 4:
                LCD_Draw_One_Row(i,2,0x01); 
                LCD_Draw_One_Row(i,3,0x00);
                if(Yplay!=0x80)
                {
                  LCD_Draw_One_Row(i,4,Yplay+0x80);
                }
                else
                  LCD_Draw_One_Row(i,4,0x80);
                break;
              case 3:
                LCD_Draw_One_Row(i,2,0x01);
                LCD_Draw_One_Row(i,3,Yplay);
                LCD_Draw_One_Row(i,4,0x80);
                break;
              case 2:
                LCD_Draw_One_Row(i,2,Yplay+0x01);
                LCD_Draw_One_Row(i,3,0x00);
                LCD_Draw_One_Row(i,4,0x80);
                break;
              }
              
          }
          //Snake_Init();         
          Gamestatus_Pre=Gamestatus;            
          Snake_Move();
          break;
      }
      if(Gamestatus == OVER)
      {
         Game_Mode=0;
         LCD_CLS();
         break;
      }
   }
}*/

void TC_Game(void)
{
   if (Game_Mode ==0) 
   {  
       Game_Mode=1;
       LCD_CLS();      
       LCD_P8x16Str(12,2,"  Game!!! ");
   }
}

int16 TURN=0;

void Telecontrol(void)   
{
    if(Game_Mode_)
    {           
        CSB_EN=0;
        disable_irq(PIT_IRQn);       
        LCD_P6x8Str(2,7,"G*");
        if(Game_Key == game_UP)
        {
            Motor_Zheng(300);
        }       
        else if(Game_Key == game_DOWN)
        {
            Motor_Fan(300);
        }
        else if(Game_Key == game_LEFT)
        {   
            TURN+=111;
            Set_Servo_PWM(TURN);
        }
        else if(Game_Key == game_RIGHT)
        {   
            TURN-=111;
            Set_Servo_PWM(TURN);
        }
        else
        {
           Motor_Zheng(0);
        }
    }
    else
    {
        //CSB_EN=1;
        enable_irq (PIT_IRQn);   //使能PIT，即允许PIT产生中断
    }
    

}

void B_Trix(void)
{
    for(;;)
    {
       
    }
}

